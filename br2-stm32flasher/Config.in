## br2-stm32flasher/Config.in
```kconfig
source "$BR2_EXTERNAL_STM32FLASHER_PATH/package/rpi4-bootfw/Config.in"
source "$BR2_EXTERNAL_STM32FLASHER_PATH/package/stm32cubeprog/Config.in"
```

## br2-stm32flasher/configs/rpi4_stm32flasher_defconfig
```kconfig
BR2_aarch64=y
BR2_cortex_a72=y
BR2_ARM_FPU_VFPV4=y
BR2_DL_DIR="$(TOPDIR)/../dl/br"
BR2_TOOLCHAIN_BUILDROOT_GLIBC=y
BR2_KERNEL_HEADERS_6_12=y
BR2_BINUTILS_VERSION_2_44_X=y
BR2_GCC_VERSION_14_X=y
BR2_TOOLCHAIN_BUILDROOT_CXX=y
BR2_TARGET_GENERIC_HOSTNAME="stm32flasher"
BR2_TARGET_GENERIC_ISSUE="STM32 parallel flasher (RPi4) - run flash-all"
BR2_TARGET_GENERIC_ROOT_PASSWD="stm32"
BR2_TARGET_GENERIC_GETTY_PORT="tty1"
BR2_ROOTFS_DEVICE_CREATION_DYNAMIC_MDEV=y
BR2_ROOTFS_OVERLAY="$(BR2_EXTERNAL_STM32FLASHER_PATH)/board/rpi4/overlay"
BR2_ROOTFS_POST_BUILD_SCRIPT="$(BR2_EXTERNAL_STM32FLASHER_PATH)/board/rpi4/post-build.sh"
BR2_ROOTFS_POST_IMAGE_SCRIPT="$(BR2_EXTERNAL_STM32FLASHER_PATH)/board/rpi4/post-image.sh"
BR2_LINUX_KERNEL=y
BR2_LINUX_KERNEL_CUSTOM_VERSION=y
BR2_LINUX_KERNEL_CUSTOM_VERSION_VALUE="6.12.94"
BR2_LINUX_KERNEL_USE_ARCH_DEFAULT_CONFIG=y
BR2_LINUX_KERNEL_CONFIG_FRAGMENT_FILES="$(BR2_EXTERNAL_STM32FLASHER_PATH)/board/rpi4/linux.fragment"
BR2_LINUX_KERNEL_DTS_SUPPORT=y
BR2_LINUX_KERNEL_INTREE_DTS_NAME="broadcom/bcm2711-rpi-4-b"
BR2_LINUX_KERNEL_NEEDS_HOST_OPENSSL=y
BR2_PACKAGE_LIBUSB=y
BR2_PACKAGE_DROPBEAR=y
BR2_TARGET_ROOTFS_EXT2=y
BR2_TARGET_ROOTFS_EXT2_4=y
BR2_TARGET_ROOTFS_EXT2_SIZE="1G"
# BR2_TARGET_ROOTFS_TAR is not set
BR2_PACKAGE_HOST_DOSFSTOOLS=y
BR2_PACKAGE_HOST_GENIMAGE=y
BR2_PACKAGE_HOST_MTOOLS=y
BR2_ROOTFS_USERS_TABLES="$(BR2_EXTERNAL_STM32FLASHER_PATH)/board/rpi4/users.txt"
BR2_PACKAGE_STM32CUBEPROG=y
BR2_STRIP_EXCLUDE_DIRS="opt/stm32cubeprog"
BR2_GENERATE_LOCALE="en_US.UTF-8"
BR2_PACKAGE_RPI4_BOOTFW=y
```

## br2-stm32flasher/package/rpi4-bootfw/Config.in
```kconfig
config BR2_PACKAGE_RPI4_BOOTFW
	bool "rpi4-bootfw"
	depends on BR2_aarch64
	help
	  Raspberry Pi 4 GPU boot firmware (start4.elf, fixup4.dat),
	  pinned to one commit of github.com/raspberrypi/firmware.
	  Installed into the images directory for the boot partition.
```

## br2-stm32flasher/package/stm32cubeprog/Config.in
```kconfig
config BR2_PACKAGE_STM32CUBEPROG
	bool "stm32cubeprog"
	depends on BR2_aarch64
	select BR2_PACKAGE_LIBUSB
	help
	  STMicroelectronics STM32CubeProgrammer CLI (Linux Arm64 package).
	  The .deb.zip must be placed in BR2_DL_DIR/stm32cubeprog manually
	  (download requires a myST login).
```
